## conf/layer.conf
```bitbake
BBPATH .= ":${LAYERDIR}"
BBFILES += " \
    ${LAYERDIR}/recipes-*/*/*.bb \
    ${LAYERDIR}/recipes-*/*/*.bbappend \
"

BBFILE_COLLECTIONS += "tegra-meerkat"
BBFILE_PATTERN_tegra-meerkat = "^${LAYERDIR}/"
BBFILE_PRIORITY_tegra-meerkat = "6"

LAYERVERSION_tegra-meerkat = "1"

LAYERDEPENDS_tegra-meerkat = "tegra"

LAYERSERIES_COMPAT_tegra-meerkat = "sumo"

# Recipe modifications for other layers that may be included in the build
BBFILES += "${@' '.join('${LAYERDIR}/external/%s/recipes*/*/*.bb' % layer \
               for layer in BBFILE_COLLECTIONS.split() if os.path.exists(os.path.join('${LAYERDIR}','external',layer)))}"
BBFILES += "${@' '.join('${LAYERDIR}/external/%s/recipes*/*/*.bbappend' % layer \
               for layer in BBFILE_COLLECTIONS.split() if os.path.exists(os.path.join('${LAYERDIR}','external',layer)))}"
```

## conf/machine/include/meerkat.inc
```bitbake
#@TYPE: COM
#@NAME: Avionic Design Meerkat COM
#@DESCRIPTION: Avionic Design Meerkat Computer on a Module

MACHINEOVERRIDES =. "meerkat:"

# Override the kernel
PREFERRED_PROVIDER_virtual/kernel ?= "linux-l4t-meerkat"

# Parameters to build a valid uImage or fitImage
UBOOT_LOADADDRESS = "0x82000000"
ENTRYPOINT = "0x82000000"

require conf/machine/include/tegra124.inc

# The COM has an integrated eMMC
MACHINE_FEATURES += "ext2 vfat"
# The SoC and the PMU have an RTC but the board has to provides backed
# up power for them to keep the time as is expected from an RTC.
MACHINE_FEATURES_BACKFILL_CONSIDERED += "rtc"

# Install the meerkat specific configs
MACHINE_ESSENTIAL_EXTRA_RDEPENDS += "meerkat-configs"

# Add a package arch for all Meerkat based machines
COM_PKGARCH = "${SOC_FAMILY_PKGARCH}_meerkat"
PACKAGE_EXTRA_ARCHS_append = " ${COM_PKGARCH}"
```

## conf/machine/meerkat-evalboard.conf
```bitbake
#@TYPE: Machine
#@NAME: Avionic Design Meerkat Evaluation Board
#@DESCRIPTION: Evaluation board for the Meerkat COM from Avionic Design

require conf/machine/include/meerkat.inc

KERNEL_DEVICETREE ?= "tegra124-meerkat-evalboard.dtb"

MACHINE_FEATURES += "pci rtc serial usbhost usbgadget"
```
